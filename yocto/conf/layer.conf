## yocto/conf/layer.conf
```bitbake
# SPDX-License-Identifier: MIT

BBPATH .= ":${LAYERDIR}"
BBFILES += "${LAYERDIR}/recipes-*/*/*.bb"
BBFILE_COLLECTIONS += "mooshrevolt"
BBFILE_PATTERN_mooshrevolt = "^${LAYERDIR}/"
BBFILE_PRIORITY_mooshrevolt = "6"
LAYERDEPENDS_mooshrevolt = "core flutter-layer"
LAYERSERIES_COMPAT_mooshrevolt = "wrynose"
```
